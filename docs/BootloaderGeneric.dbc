VERSION ""

NS_ :

BS_:

BU_: Tester
VAL_TABLE_ BL_OpModeFlag 2 "MODE_BOOT" 1 "MODE_FLASH" 0 "MODE_IDLE" ;
VAL_TABLE_ BL_MessageType 3 "M_APP_DATA" 2 "M_METADATA" 1 "M_FLAG_SET" 0 "M_NONE" ;

BO_ 2348941054 BL_TxMessage: 8 Vector__XXX

BO_ 2348875536 BL_RxMessage: 8 Tester
 SG_ BL_RxECUID : 4|4@1+ (1,0) [0|0] "" Vector__XXX
 SG_ BL_CRCValue m2 : 32|32@1+ (1,0) [0|0] "" Vector__XXX
 SG_ BL_OpModeFlag m1 : 8|2@1+ (1,0) [0|0] "" Vector__XXX
 SG_ BL_ApplicationLength m2 : 8|24@1+ (1,0) [0|16777215] "" Vector__XXX
 SG_ BL_ApplicationData m3 : 8|32@1+ (1,0) [0|0] "" Vector__XXX
 SG_ BL_MessageType M : 0|4@1+ (1,0) [0|0] "" Vector__XXX

CM_ SG_ 2348875536 BL_CRCValue "Pre-Computed CRC value for application data";
CM_ SG_ 2348875536 BL_OpModeFlag "Operational mode request for bootloader.";
CM_ SG_ 2348875536 BL_ApplicationLength "Length of Application to dlownload in bytes";
CM_ SG_ 2348875536 BL_ApplicationData "Application binary data to place in ECU flash";
CM_ SG_ 2348875536 BL_MessageType "Multiplexer signal for BL commands";
BA_DEF_ SG_  "SigType" ENUM  "Default","Range","RangeSigned","ASCII","Discrete","Control","ReferencePGN","DTC","StringDelimiter","StringLength","StringLengthControl","MessageCounter","MessageChecksum";
BA_DEF_ SG_  "GenSigEVName" STRING ;
BA_DEF_ SG_  "GenSigILSupport" ENUM  "No","Yes";
BA_DEF_ SG_  "GenSigSendType" ENUM  "Cyclic","OnWrite","OnWriteWithRepetition","OnChange","OnChangeWithRepetition","IfActive","IfActiveWithRepetition","NoSigSendType";
BA_DEF_ BO_  "GenMsgILSupport" ENUM  "No","Yes";
BA_DEF_ BU_  "NmStationAddress" INT 0 255;
BA_DEF_ BO_  "GenMsgSendType" ENUM  "cyclic","NotUsed","IfActive","NotUsed","NotUsed","NotUsed","NotUsed","NotUsed","noMsgSendType";
BA_DEF_ BO_  "GenMsgRequestable" INT 0 1;
BA_DEF_  "DBName" STRING ;
BA_DEF_  "BusType" STRING ;
BA_DEF_  "ProtocolType" STRING ;
BA_DEF_ BO_  "VFrameFormat" ENUM  "StandardCAN","ExtendedCAN","reserved","J1939PG";
BA_DEF_DEF_  "SigType" "Default";
BA_DEF_DEF_  "GenSigEVName" "Env@Nodename_@Signame";
BA_DEF_DEF_  "GenSigILSupport" "Yes";
BA_DEF_DEF_  "GenSigSendType" "NoSigSendType";
BA_DEF_DEF_  "GenMsgILSupport" "Yes";
BA_DEF_DEF_  "NmStationAddress" 254;
BA_DEF_DEF_  "GenMsgSendType" "noMsgSendType";
BA_DEF_DEF_  "GenMsgRequestable" 1;
BA_DEF_DEF_  "DBName" "";
BA_DEF_DEF_  "BusType" "CAN";
BA_DEF_DEF_  "ProtocolType" "J1939";
BA_DEF_DEF_  "VFrameFormat" "J1939PG";
BA_ "DBName" "BootloaderGeneric";
BA_ "NmStationAddress" BU_ Tester 16;
VAL_ 2348875536 BL_OpModeFlag 2 "MODE_BOOT" 1 "MODE_FLASH" 0 "MODE_IDLE" ;
VAL_ 2348875536 BL_MessageType 3 "M_APP_DATA" 2 "M_METADATA" 1 "M_FLAG_SET" 0 "M_NONE" ;
